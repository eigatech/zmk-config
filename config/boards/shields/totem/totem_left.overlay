/*
 * Copyright (c) 2022 The ZMK Contributors
 *
 * SPDX-License-Identifier: MIT
 */

 #include "totem.dtsi"

 &kscan0 {
    compatible = "zmk,kscan-gpio-matrix";
    wakeup-source;

    col-gpios
        = <&xiao_d 4 GPIO_ACTIVE_HIGH>
        , <&xiao_d 5 GPIO_ACTIVE_HIGH>
        , <&xiao_d 10 GPIO_ACTIVE_HIGH>
        , <&xiao_d 9 GPIO_ACTIVE_HIGH>
        , <&xiao_d 8 GPIO_ACTIVE_HIGH>
        ;

    row-gpios
        = <&xiao_d 0 (GPIO_ACTIVE_HIGH | GPIO_PULL_DOWN)>
        , <&xiao_d 1 (GPIO_ACTIVE_HIGH | GPIO_PULL_DOWN)>
        , <&xiao_d 2 (GPIO_ACTIVE_HIGH | GPIO_PULL_DOWN)>
        , <&xiao_d 3 (GPIO_ACTIVE_HIGH | GPIO_PULL_DOWN)>
        ;
 };