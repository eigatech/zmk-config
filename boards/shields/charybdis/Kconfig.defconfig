## boards/shields/charybdis/Kconfig.defconfig
```kconfig
if SHIELD_CHARYBDIS_DONGLE

config ZMK_KEYBOARD_NAME
	default "Charybdis"

config ZMK_SPLIT_ROLE_CENTRAL
	default y

endif

if SHIELD_CHARYBDIS_DONGLE || SHIELD_CHARYBDIS_LEFT || SHIELD_CHARYBDIS_RIGHT

config ZMK_SPLIT
	default y
	
endif
```

## config/boards/shields/corne/Kconfig.defconfig
```kconfig
if SHIELD_CORNE_CENTRAL_DONGLE

config ZMK_KEYBOARD_NAME
    default "Corne"

config ZMK_SPLIT_ROLE_CENTRAL
    default y

endif

if SHIELD_CORNE_CENTRAL_DONGLE || SHIELD_CORNE_PERIPHERAL_LEFT || SHIELD_CORNE_PERIPHERAL_RIGHT

config ZMK_SPLIT
    default y

endif
```

## config/boards/shields/corne/Kconfig.shield
```kconfig
# Copyright (c) 2020 Pete Johanson
# SPDX-License-Identifier: MIT

config SHIELD_CORNE_CENTRAL_DONGLE
    def_bool $(shields_list_contains,corne_central_dongle)

config SHIELD_CORNE_PERIPHERAL_LEFT
    def_bool $(shields_list_contains,corne_peripheral_left)

config SHIELD_CORNE_PERIPHERAL_RIGHT
    def_bool $(shields_list_contains,corne_peripheral_right)
```

## config/boards/shields/totem/Kconfig.defconfig
```kconfig
# Copyright (c) 2022 The ZMK Contributors
# SPDX-License-Identifier: MIT

if SHIELD_TOTEM_DONGLE

config ZMK_KEYBOARD_NAME
    default "TOTEM"
    
config ZMK_SPLIT_ROLE_CENTRAL
    default y

config ZMK_USB
    default y

endif

if SHIELD_TOTEM_LEFT || SHIELD_TOTEM_RIGHT || SHIELD_TOTEM_DONGLE

config ZMK_SPLIT
    default y

config ZMK_BLE
    default y

endif
```

## config/boards/shields/totem/Kconfig.shield
```kconfig
# Copyright (c) 2022 The ZMK Contributors
# SPDX-License-Identifier: MIT

config SHIELD_TOTEM_LEFT
    def_bool $(shields_list_contains,totem_left)

config SHIELD_TOTEM_RIGHT
    def_bool $(shields_list_contains,totem_right)

config SHIELD_TOTEM_DONGLE
    def_bool $(shields_list_contains,totem_dongle)
```

## config/west.yml
```yaml
manifest:
  remotes:
    - name: zmkfirmware
      url-base: https://github.com/zmkfirmware
  projects:
    - name: zmk
      remote: zmkfirmware
      revision: v0.2
      import: app/west.yml
  self:
    path: config
```
