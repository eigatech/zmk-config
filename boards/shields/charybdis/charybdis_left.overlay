#include "charybdis.dtsi"
#include "charybdis_3610.dtsi"

&kscan0 {
	compatible = "zmk,kscan-gpio-matrix";
	
	col-gpios
		= <&pro_micro 19 (GPIO_ACTIVE_HIGH | GPIO_PULL_DOWN)>
		, <&pro_micro 20 (GPIO_ACTIVE_HIGH | GPIO_PULL_DOWN)>
		, <&pro_micro 10 (GPIO_ACTIVE_HIGH | GPIO_PULL_DOWN)>
		, <&pro_micro 6 (GPIO_ACTIVE_HIGH | GPIO_PULL_DOWN)>
		, <&pro_micro 7 (GPIO_ACTIVE_HIGH | GPIO_PULL_DOWN)>
		, <&pro_micro 8 (GPIO_ACTIVE_HIGH | GPIO_PULL_DOWN)>
		;

	row-gpios
		= <&pro_micro 18 GPIO_ACTIVE_HIGH>
		, <&pro_micro 5 GPIO_ACTIVE_HIGH>
		, <&pro_micro 4 GPIO_ACTIVE_HIGH>
		, <&pro_micro 9 GPIO_ACTIVE_HIGH>
		;
};

/ {
	vtrackball: virtual_input_trackball {
		compatible = "zmk,virtual-input";
	};
};